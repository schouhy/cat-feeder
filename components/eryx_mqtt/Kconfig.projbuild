## components/eryx_mqtt/Kconfig.projbuild
```kconfig
menu "Eryx MQTT IoT Logger Configuration"
    config MQTT_USERNAME
        string "MQTT username"
        default ""
        help
            The username

    config MQTT_PASSWORD
        string "MQTT password"
        default ""
        help
            The password
endmenu
```

## main/Kconfig.projbuild
```kconfig
menu "Example Configuration"
    config WIFI_SSID
        string "Wifi SSID"
        default "SSID"
        help
            The Wifi SSID

    config WIFI_PASSWORD
        string "Wifi password"
        default "password"
        help
            The Wifi password

endmenu
```
